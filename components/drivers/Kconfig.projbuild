## components/drivers/Kconfig.projbuild
```kconfig
menu "Wi-Fi Configuration"

config WIFI_SSID
    string "Wi-Fi SSID"
    default "myssid"

config WIFI_PASS
    string "Wi-Fi Password"
    default "mypassword"

config MQTT_BROKER_URI
    string "MQTT broker URI"
    default "mqtt://192.168.1.1:1883"
    help
      URI of the MQTT broker, e.g. mqtt://host:port

config MQTT_DEVICE_NAME
    string "Friendly device name"
    default "ESP32 Meteopod"
    help
      This name will appear in Home Assistant as the model name of your device.
      It is used in MQTT discovery under the "device.model" field.

endmenu
```

## components/ota/Kconfig
```kconfig
menu "OTA Update Configuration"

config OTA_FIRMWARE_URL
    string "Firmware update URL"
    default "http://<host>:<port>/esp32-firmware/firmware.bin"
    help
      Full URL to the OTA firmware binary.
      Replace <host> and <port> with your MinIO or HTTP server values.

endmenu
```

## components/sensors/Kconfig.projbuild
```kconfig
menu "Wind Sensor Configuration"

config WIND_DIRECTION_SENSOR_VOLTAGE_OFFSET_MV
    int "Voltage offset for wind direction sensor (in mV)"
    default 0
    range -500 500
    help
      Apply this offset to the ADC voltage reading to account for calibration drift
      or hardware-level bias.

endmenu
```

## main/Kconfig.projbuild
```kconfig
menu "Wi-Fi Configuration"

config WIFI_SSID
    string "Wi-Fi SSID"
    default "myssid"

config WIFI_PASS
    string "Wi-Fi Password"
    default "mypassword"

endmenu
```

## sdkconfig.defaults.example
```kconfig
# FILL AND RENAME TO sdkconfig.defaults TO USE

# App Version
CONFIG_APP_PROJECT_VER_FROM_CONFIG=y
CONFIG_APP_PROJECT_VER="v0.0.3"

# Wi-Fi
CONFIG_WIFI_SSID="YourWiFiSSID"
CONFIG_WIFI_PASS="YourWiFiPassword"

# MQTT
CONFIG_MQTT_BROKER_URI="mqtt://192.168.1.100:1883"
CONFIG_MQTT_DEVICE_NAME="Meteopod Dev - Example"

# Flash size
CONFIG_ESPTOOLPY_FLASHSIZE_4MB=y

# OTA related
CONFIG_ESP_HTTPS_OTA_ALLOW_HTTP=y
CONFIG_PARTITION_TABLE_CUSTOM=y
CONFIG_PARTITION_TABLE_CUSTOM_FILENAME="partitions.csv"
CONFIG_BOOTLOADER_APP_ROLLBACK_ENABLE=y
CONFIG_BOOTLOADER_APP_ELF_SHA256=y
CONFIG_OTA_DATA_ERASE=y
CONFIG_OTA_FIRMWARE_URL="http://192.168.1.100:9000/firmware/esp32-meteopod.bin"
```
